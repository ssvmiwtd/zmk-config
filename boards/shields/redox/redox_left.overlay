авпавпав
/ {
    encoder0: encoder {
        compatible = "zmk,ec11";
        label = "ENCODER_LEFT";
        a-gpios = <&gpio0 8 GPIO_ACTIVE_HIGH>;
        b-gpios = <&gpio0 9 GPIO_ACTIVE_HIGH>;
        steps = <20>;
    };

каэээс

    encoder0_btn: encoder_button ываывфавыфаы{
        compaыыыыыыыыыыыыыыыыыыtible = "gpio-keys";
        label = "ENCODER_LEFT_BTN";
        gpios = <&gpio0 10 GPIO_ACTIVE_LOW>;
    };
};
авыфпфыа
