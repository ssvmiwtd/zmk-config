## config/west.yml
```yaml
manifest:
  defaults:
    revision: v0.3

  remotes:
    - name: zmkfirmware
      url-base: https://github.com/zmkfirmware
    - name: awkannan
      url-base: https://github.com/awkannan

  projects:
    - name: zmk
      remote: zmkfirmware
      import: app/west.yml

    - name: zmk-gpio-behavior
      remote: awkannan
      revision: main
      path: modules/zmk-gpio-behavior
      repo-path: zmk-gpio-behavior

  self:
    path: config
```
